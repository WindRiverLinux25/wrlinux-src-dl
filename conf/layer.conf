## conf/layer.conf
```bitbake
# Copyright (C) 2023 Wind River Systems, Inc.
#
BBFILE_COLLECTIONS += "wrlinux-src-dl"
BBFILE_PATTERN_wrlinux-src-dl = ""
BBFILE_PATTERN_IGNORE_EMPTY_wrlinux-src-dl = "1"

# This should only be incremented on significant changes that will
# cause compatibility issues with other layers
LAYERVERSION_wrlinux-src-dl = "1"
LAYERSERIES_COMPAT_wrlinux-src-dl = "styhead"

WRLINUX_DL_VERSION ?= "5.1"

# We have a pre-populated downloads directory, add to PREMIRRORS
# The git sources saved in wrlinux-src-dl/git, other types of sources
# are saved in foo-dl[-<version>]/downloads
PREMIRRORS:append = " \
     git://.*/.* git://${LAYERDIR}/git/MIRRORNAME;protocol=file \n \
     gitsm://.*/.* gitsm://${LAYERDIR}/git/MIRRORNAME;protocol=file \n \
    .*://.*/.* file://${LAYERDIR}/../oe-core-dl-${WRLINUX_DL_VERSION}/downloads \n \
    .*://.*/.* file://${LAYERDIR}/../meta-openembedded-dl-${WRLINUX_DL_VERSION}/downloads \n \
    .*://.*/.* file://${LAYERDIR}/../meta-anaconda-dl/downloads \n \
    .*://.*/.* file://${LAYERDIR}/../meta-browser-dl-${WRLINUX_DL_VERSION}/downloads \n \
    .*://.*/.* file://${LAYERDIR}/../meta-secure-core-dl/downloads \n \
    .*://.*/.* file://${LAYERDIR}/../meta-intel-dl/downloads \n \
    .*://.*/.* file://${LAYERDIR}/../meta-intel-qat-dl/downloads \n \
    .*://.*/.* file://${LAYERDIR}/../meta-mingw-dl/downloads \n \
    .*://.*/.* file://${LAYERDIR}/../meta-raspberrypi-dl-${WRLINUX_DL_VERSION}/downloads \n \
    .*://.*/.* file://${LAYERDIR}/../meta-security-dl/downloads \n \
    .*://.*/.* file://${LAYERDIR}/../meta-tensorflow-dl-${WRLINUX_DL_VERSION}/downloads \n \
    .*://.*/.* file://${LAYERDIR}/../meta-virtualization-dl-${WRLINUX_DL_VERSION}/downloads \n \
    .*://.*/.* file://${LAYERDIR}/../meta-cloud-services-dl-${WRLINUX_DL_VERSION}/downloads \n \
    .*://.*/.* file://${LAYERDIR}/../meta-xilinx-dl/downloads \n \
    .*://.*/.* file://${LAYERDIR}/../wr-ota-dl/downloads \n \
    .*://.*/.* file://${LAYERDIR}/../meta-clang-dl/downloads \n \
"

TS_DL_DIR = "${LAYERDIR}/../meta-tensorflow-dl-${WRLINUX_DL_VERSION}/distdir"
```
